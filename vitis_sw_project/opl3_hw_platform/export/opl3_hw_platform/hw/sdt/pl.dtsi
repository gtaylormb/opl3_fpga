/ {
	amba_pl: amba_pl {
		ranges;
		compatible = "simple-bus";
		#address-cells = <1>;
		#size-cells = <1>;
		opl3_fpga_0: opl3_fpga@43c00000 {
			xlnx,rable = <0>;
			compatible = "xlnx,opl3-fpga-2.0";
			status = "okay";
			clock-names = "s_axi_aclk";
			xlnx,ip-name = "opl3_fpga";
			xlnx,edk-iptype = "PERIPHERAL";
			reg = <0x43c00000 0x10000>;
			clocks = <&clkc 15>;
			xlnx,name = "opl3_fpga_0";
		};
	};
};
